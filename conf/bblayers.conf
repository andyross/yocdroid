## conf/bblayers.conf
```bitbake
LCONF_VERSION = "1"
LAYER_CONF_VERSION = "1"

BBPATH = "${TOPDIR}"

BBFILES = "${TOPDIR}/recipes/*/*.bb ${TOPDIR}/recipes/*/*.bbappend ${TOPDIR}/classes/*.bbclass"

BBLAYERS := " \
  ${TOPDIR} \
  ${TOPDIR}/poky/meta \
  ${TOPDIR}/poky/meta-yocto \
  ${TOPDIR}/poky/meta-yocto-bsp \
"
```

## conf/local.conf
```bitbake
CONF_VERSION = "1"

# The MACHINE variable is passed in from the Makefile that calls
# bitbake, but it can't hurt to to have a sane default.
MACHINE ?= "qemuarm"

DISTRO = "poky"

# Parallel build settings.  This works well for all but very large
# multi-socket systems.
BB_NUMBER_THREADS = "8"
PARALLEL_MAKE = "-j 8"

# Where to put the downloaded files.  This drops it in the user's home
# directory so it's always preserved across builds.
DL_DIR = "${HOME}/oe-downloads"

# Don't try to resolve a failing patch interactively via subshell, just die
PATCHRESOLVE = "noop"
```

## conf/machine/yd-arm.conf
```bitbake
# ARMv6 machine definition for baseline Android devices

KERNEL_IMAGETYPE = "zImage"

include yd-generic.inc
require conf/machine/include/tune-arm1136jf-s.inc
```

## conf/machine/yd-armv7.conf
```bitbake
# ARMv7-A machine definition for modern Android devices.  Uses Cortex
# A9 tuning but will run on A8 CPUs.

KERNEL_IMAGETYPE = "zImage"

include yd-generic.inc
require conf/machine/include/tune-cortexa9.inc
```

## conf/machine/yd-generic.inc
```bitbake
# This stuff mostly copied from the upstream qemu.conf:

# Used to enable package selection in upstream packagegroup recipes
# (though not by our image)
MACHINE_FEATURES = "alsa bluetooth usbgadget screen"

# Don't include kernel in the image
RDEPENDS_kernel-base = ""

# Use the default upstream kernel when one must be built
PREFERRED_PROVIDER_virtual/kernel ?= "linux-yocto"
```

## conf/machine/yd-x86-64.conf
```bitbake
# Generic x86_64 definition, mostly cloned from upstream qemux86-64

KERNEL_IMAGETYPE = "bzImage"
MACHINE_FEATURES += "x86"

include yd-generic.inc
require conf/machine/include/tune-x86_64.inc
```

## conf/machine/yd-x86.conf
```bitbake
# Generic i586 architecture, mostly cloned from qemux86

KERNEL_IMAGETYPE = "bzImage"
MACHINE_FEATURES += "x86"

include yd-generic.inc
require conf/machine/include/tune-i586.inc
```
